## main/Kconfig.projbuild
```kconfig
menu "BLE Configuration"

config BLE_DEVICE_NAME
    string "BLE device name (advertised name)"
    default "HatefulBlue"
    help
        The name advertised over BLE and shown in iOS Settings > Bluetooth.
        Maximum 31 characters (BLE advertisement payload limit).

config NIMBLE_LOG_LEVEL
    int "NimBLE runtime log level (0=NONE,1=ERROR,2=WARN,3=INFO,4=DEBUG,5=VERBOSE)"
    default 2
    help
        Select the runtime log level for the NimBLE host. Lower values reduce
        console spam from GATT/ATT operations. The value maps directly to
        esp_log_level_t used by esp_log_level_set().

config DIAG_NOTIFY_INTERVAL_SEC
    int "Diagnostic NOTIFY interval (seconds, 0 = disabled)"
    default 30
    range 0 300
    help
        How often (in seconds) the BLE diagnostic characteristic pushes an
        updated JSON report to subscribed clients via NOTIFY.
        Set to 0 to disable periodic notifications entirely — READ still
        works on demand at any interval.

endmenu

menu "GPS Configuration"

config GPS_DIAG_LOG
    bool "Enable GPS diagnostic logging"
    default y
    help
        When enabled, the GPS task emits a periodic 30-second health summary
        (chars, checksums, satellites, HDOP, fix state, baud) and logs every
        fix-state transition, satellite-count change, and 1 Hz position fix
        to the console via ESP_LOGI.
        Disable to reduce console output in production builds while keeping
        all UART error/warning and watchdog messages intact.

endmenu

menu "LoRa / Meshtastic Configuration"

config LORA_ENABLED
    bool "Enable LoRa Meshtastic receive"
    default y
    help
        Listen on the configured frequency for Meshtastic packets.
        Received text messages are decrypted with the default channel PSK
        and shown on the display for 5 seconds.
        Uses the SX1262 on SPI2 (NSS=GPIO8, SCK=9, MOSI=10, MISO=11,
        RST=12, BUSY=13, DIO1=14) — Heltec Wireless Tracker 1.1 schematic.

config LORA_CHANNEL_NUM
    int "Meshtastic channel slot number (0 = auto from name hash)"
    default 0
    range 0 104
    depends on LORA_ENABLED
    help
        Meshtastic frequency slot number, matching the "channel_num" field
        in the LoRa configuration of nearby Meshtastic nodes.

        0 = derive from channel name hash (matches Meshtastic factory default).
        1–104 = explicit slot number (1-based, same as Meshtastic config).

        The frequency is computed as:
          freq = 902.0 MHz + bw/2 + (slot - 1) * bw
        where bw = 250 kHz for LongFast.

        If your nearby Meshtastic node uses the default "LongFast" preset
        with no custom channel_num, leave this at 0.

config LORA_FREQUENCY_HZ
    int "Channel centre frequency override (Hz, 0 = auto)"
    default 0
    depends on LORA_ENABLED
    help
        Expert override: set a specific centre frequency in Hz.
        When non-zero, this overrides the channel_num-based calculation.
        Leave at 0 for normal operation (auto-computed from channel_num).
          Example: 906875000 for slot 20 of US LongFast.

choice LORA_MODEM_PRESET
    prompt "Meshtastic modem preset"
    depends on LORA_ENABLED
    default LORA_PRESET_LONG_FAST
    help
        Select the LoRa modem parameters to match the Meshtastic nodes
        in your area.  LongFast is the factory default for all regions.

    config LORA_PRESET_LONG_FAST
        bool "LongFast  (SF11 / BW 250 kHz / CR 4/5) — factory default"

    config LORA_PRESET_LONG_SLOW
        bool "LongSlow  (SF12 / BW 125 kHz / CR 4/8)"

    config LORA_PRESET_MEDIUM_SLOW
        bool "MediumSlow (SF10 / BW 250 kHz / CR 4/5)"

    config LORA_PRESET_SHORT_FAST
        bool "ShortFast  (SF7  / BW 250 kHz / CR 4/5)"

endchoice

config LORA_TX_ENABLED
    bool "Enable LoRa transmit (mesh participation)"
    default y
    depends on LORA_ENABLED
    help
        Allow the device to transmit LoRa packets (position broadcasts,
        node identity, etc.) in addition to receiving them.
        Disable for a passive monitor that only listens.
        IMPORTANT: The configured frequency and TX power must comply with
        local radio regulations (FCC Part 15/97 for US_915, ETSI EN 300 220
        for EU_868).

config LORA_TX_POWER_DBM
    int "TX output power (dBm)"
    default 22
    range 1 22
    depends on LORA_TX_ENABLED
    help
        SX1262 transmit power in dBm.  Maximum is +22 dBm.
        Reduce for regulatory compliance or to save power.
        US ISM 915 MHz: FCC Part 15.247 allows up to +30 dBm EIRP.
        EU 868 MHz: ETSI EN 300 220 limits to +14 dBm ERP (≈+16 dBm EIRP).

config LORA_POSITION_TX_INTERVAL_SEC
    int "GPS position broadcast interval (seconds)"
    default 300
    range 30 3600
    depends on LORA_TX_ENABLED
    help
        How often to broadcast a POSITION_APP packet on the mesh when a
        GPS fix is available.  Default is 300 s (5 minutes), matching the
        Meshtastic default position broadcast rate.
        Minimum 30 s — shorter intervals increase channel congestion.
        The position is only sent when gps.isFixed() is true; the interval
        timer still advances while waiting for a fix so the first broadcast
        fires promptly once a fix is acquired.

config LORA_NODEINFO_TX_INTERVAL_SEC
    int "NodeInfo broadcast interval (seconds)"
    default 1800
    range 60 86400
    depends on LORA_TX_ENABLED
    help
        How often to re-broadcast a NODEINFO_APP packet (node identity).
        The first broadcast happens immediately after SX1262 init succeeds.
        Default is 1800 s (30 minutes), matching Meshtastic firmware behaviour.

config LORA_TELEMETRY_TX_INTERVAL_SEC
    int "Device telemetry broadcast interval (seconds)"
    default 600
    range 60 3600
    depends on LORA_TX_ENABLED
    help
        How often to broadcast a TELEMETRY_APP Device Metrics packet.
        Sends uptime and a nominal battery level so the device appears
        active in Meshtastic app node lists.  Default 600 s (10 minutes).

config MESH_NODE_SHORT_NAME
    string "Meshtastic node short name (1–4 chars)"
    default "BLUE"
    depends on LORA_ENABLED
    help
        Short name broadcast in NODEINFO_APP packets and shown on other
        Meshtastic devices.  Must be 1–4 printable ASCII characters.
        Can be overridden at runtime via NVS (persisted across reboots).

config MESH_NODE_LONG_NAME
    string "Meshtastic node long name (up to 32 chars)"
    default "HatefulBlue"
    depends on LORA_ENABLED
    help
        Human-readable name broadcast in NODEINFO_APP packets.
        Up to 32 UTF-8 characters.
        Can be overridden at runtime via NVS (persisted across reboots).

choice MESH_NODE_ROLE_SEL
    prompt "Meshtastic node role"
    depends on LORA_ENABLED
    default MESH_ROLE_TRACKER
    help
        The role announced in NODEINFO_APP (User.role, field 7).
        Meshtastic uses this to assign icons and tune Smart Position
        behaviour in the app.

        CLIENT  — standard node (no icon, default position interval).
        TRACKER — GPS tracker icon, Smart Position enabled.  Best choice
                  for this hardware since it has an onboard GPS module.

    config MESH_ROLE_CLIENT
        bool "CLIENT (0) — standard Meshtastic node"

    config MESH_ROLE_TRACKER
        bool "TRACKER (5) — GPS tracker (tracker icon, Smart Position)"

endchoice

config MESH_NODE_ROLE
    int
    default 0 if MESH_ROLE_CLIENT
    default 5 if MESH_ROLE_TRACKER

choice LORA_REGION
    prompt "LoRa region"
    depends on LORA_ENABLED
    default LORA_REGION_US
    help
        Meshtastic RegionCode sent in MAP_REPORT_APP packets.  Must match
        the region configured on nearby Meshtastic nodes.

    config LORA_REGION_US
        bool "US — 915 MHz ISM band"

    config LORA_REGION_EU_868
        bool "EU_868 — 868 MHz ISM band"

    config LORA_REGION_ANZ
        bool "ANZ — Australia/New Zealand 915 MHz"

    config LORA_REGION_IN
        bool "IN — India 865 MHz"

    config LORA_REGION_SG_923
        bool "SG_923 — Singapore 923 MHz"

endchoice

config LORA_REGION_CODE
    int
    default 1  if LORA_REGION_US
    default 3  if LORA_REGION_EU_868
    default 6  if LORA_REGION_ANZ
    default 10 if LORA_REGION_IN
    default 18 if LORA_REGION_SG_923

config LORA_MAP_REPORT_TX_INTERVAL_SEC
    int "MAP_REPORT broadcast interval (seconds, 0 = disabled)"
    default 1800
    range 0 86400
    depends on LORA_TX_ENABLED
    help
        How often to broadcast a MAP_REPORT_APP (port 73) packet.
        Map reports announce this node to MQTT bridges and the public
        Meshtastic map (meshtastic.network/map) by carrying the node's
        name, hardware model, region, modem preset, and current GPS fix.
        Set to 0 to disable.  Default 1800 s (30 minutes).

endmenu

menu "Buzzer Configuration"

config BUZZER_ENABLED
    bool "Enable passive buzzer audio alerts"
    default y
    help
        Play a 5-second audio alert on GPIO 45 when a notification or
        incoming call is received.  Uses the LEDC PWM peripheral to drive
        the passive buzzer at the correct frequency — do NOT use with an
        active (self-oscillating) buzzer wired to this pin.
        Disable to silence the buzzer entirely without affecting display
        or BLE behaviour.

endmenu
```

## sdkconfig.defaults
```kconfig
CONFIG_FREERTOS_HZ=1000
CONFIG_BT_ENABLED=y
CONFIG_BT_NIMBLE_ENABLED=y
CONFIG_BT_NIMBLE_NVS_PERSIST=y
CONFIG_BLE_DEVICE_NAME="HatefulBlue"
CONFIG_NIMBLE_LOG_LEVEL_WARN=y
CONFIG_DIAG_NOTIFY_INTERVAL_SEC=30
CONFIG_BUZZER_ENABLED=y
CONFIG_LORA_ENABLED=y
# CONFIG_LORA_IS_LICENSED is not set.
# Using standard encrypted mode (chanHash=0x08, AES-128-CTR) for full
# interoperability with the default Meshtastic mesh.  PKC (X25519) is
# enabled — field 8 (public_key) is emitted in NODEINFO broadcasts.
CONFIG_LORA_CHANNEL_NUM=0
# US LongFast slot 20: 902125000 + 20*250000 = 907125000 Hz
CONFIG_LORA_FREQUENCY_HZ=907125000
CONFIG_LORA_PRESET_LONG_FAST=y
CONFIG_LORA_TX_ENABLED=y
CONFIG_LORA_TX_POWER_DBM=22
CONFIG_LORA_POSITION_TX_INTERVAL_SEC=300
CONFIG_LORA_NODEINFO_TX_INTERVAL_SEC=1800
CONFIG_LORA_TELEMETRY_TX_INTERVAL_SEC=600
CONFIG_LORA_MAP_REPORT_TX_INTERVAL_SEC=1800
CONFIG_MESH_NODE_SHORT_NAME="BLUE"
CONFIG_MESH_NODE_LONG_NAME="HatefulBlue"
# Meshtastic 2.7.x: firmware_version field in MAP_REPORT_APP
CONFIG_MESH_FIRMWARE_VERSION="2.7.15.0"
# Node role: TRACKER (5) — GPS tracker, Smart Position enabled
CONFIG_MESH_ROLE_TRACKER=y
CONFIG_MESH_NODE_ROLE=5
# LoRa region: US 915 MHz
CONFIG_LORA_REGION_US=y
CONFIG_LORA_REGION_CODE=1
# mbedTLS ECP / X25519 for Meshtastic PKC (ch=0x00 DM decryption)
CONFIG_MBEDTLS_ECP_C=y
CONFIG_MBEDTLS_ECDH_C=y
CONFIG_MBEDTLS_ECP_DP_CURVE25519_ENABLED=y
CONFIG_ESP_TASK_WDT_TIMEOUT_S=15
# Do NOT panic on TWDT — log the backtrace and continue.
# A panic-reboot from a transient load spike is worse than the starvation itself.
CONFIG_ESP_TASK_WDT_PANIC=n
CONFIG_ESP_TASK_WDT_CHECK_IDLE_TASK_CPU0=n

# ── Light sleep / tickless idle ──────────────────────────────────────────
# Allow the CPU to enter light sleep automatically during genuine FreeRTOS
# idle periods (between BLE events, LoRa DIO1 IRQs, and GPS UART events).
# FreeRTOS tickless idle consolidates 1 kHz tick interrupts into a single
# wakeup at the next scheduled task deadline, yielding measurable power
# savings with zero application code changes.
#
# Notes:
#  - CONFIG_PM_DFS_INIT_AUTO is left off (default) so the CPU stays at
#    the configured maximum frequency (240 MHz) — avoids SPI timing changes
#    during LoRa/TFT transactions.
#  - The BLE stack (NimBLE) and UART driver both support light-sleep wakeup
#    natively on the ESP32-S3.
CONFIG_PM_ENABLE=y
CONFIG_FREERTOS_USE_TICKLESS_IDLE=1
```
